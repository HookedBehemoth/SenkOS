// SPDX-License-Identifier: (GPL-2.0-only OR BSD-2-Clause)
/*
 * Copyright (C) 2024 Ryan Walklin <ryan@testtoast.com>.
 * Copyright (C) 2024 Chris Morgan <macroalpha82@gmail.com>.
 */

#include "sun50i-h700-anbernic-rg35xx-sp.dts"
#include "sun50i-h700-anbernic-sticks.dtsi"

/ {
	model = "Anbernic RG34XX-SP";
	compatible = "anbernic,rg34xx-sp", "allwinner,sun50i-h700";
	rocknix-dt-id = "sun50i-h700-anbernic-rg34xx-sp";
};

&panel {
	compatible = "anbernic,rg34xx-sp-panel", "panel-mipi-dpi-spi";
	/* The original (FOG) panel by its ID, else the BOE ("v2") one */
	firmware-names = "anbernic,rg34xx-sp-panel", "anbernic,rg34xx-sp-v2-panel";
	display-ids = <0x305200 0xffff00>;
};


&axis_rx { abs-range = <4096 0>; };
&axis_ry { abs-range = <0 4096>; };
